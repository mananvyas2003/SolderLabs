/*
 * generated-by: @solderlab/bsc (zephyr)
 * board: kicad-demo-complex-hierarchy
 * source-revision: d4248d8a874d3fa9a3a395b471588bd6ecef34e3
 * bsc-schema-version: 1.0
 * source-sha256: 63ee42bb54c9e78e0286db0f4774a936198bc75a120873bbf2487f5143ef07d1
 * DO NOT EDIT
 */

/* Board: kicad-demo-complex-hierarchy — Zephyr overlay (stub pinctrl from BSC nets) */

/ {
	chosen {
		/* No MCU detected in BSC */
	};

	solderlab_bsc_pins {
		compatible = "solderlab,bsc-pins";
		status = "okay";
	};

	pinctrl {
		/* No named nets to map into pinctrl */
	};
};
