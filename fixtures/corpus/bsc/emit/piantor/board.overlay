/*
 * generated-by: @solderlab/bsc (zephyr)
 * board: piantor
 * source-revision: cd847afb4f9a86e8c1c8e36f243140644013afb2
 * bsc-schema-version: 1.0
 * source-sha256: a4d43d685c7af4751259e24042d51514e96e2ea5d8b21a4678e0ef003de50f2b
 * DO NOT EDIT
 */

/* Board: piantor — Zephyr overlay (stub pinctrl from BSC nets) */

/ {
	chosen {
		/* No MCU detected in BSC */
	};

	solderlab_bsc_pins {
		compatible = "solderlab,bsc-pins";
		status = "okay";
	};

	pinctrl {
		/* No named nets to map into pinctrl */
	};
};
