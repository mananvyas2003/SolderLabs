/*
 * generated-by: @solderlab/bsc (zephyr)
 * board: kintex-pcie
 * source-revision: 056792c009a8920d4ef11e76ba3284ee58376078
 * bsc-schema-version: 1.0
 * source-sha256: 7163b90302e2264fd0d17a43ec9ff7640c42c0b8fcd355b6678c22a646050323
 * DO NOT EDIT
 */

/* Board: kintex-pcie — Zephyr overlay (stub pinctrl from BSC nets) */

/ {
	chosen {
		/* No MCU detected in BSC */
	};

	solderlab_bsc_pins {
		compatible = "solderlab,bsc-pins";
		status = "okay";
	};

	pinctrl {
		/* No named nets to map into pinctrl */
	};
};
